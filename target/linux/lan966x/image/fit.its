## target/linux/lan966x/image/fit.its
```
/dts-v1/;
/ {
	description = "Image Tree Source file for lan966x";
	#address-cells = <1>;

	images {
		kernel {
			description = "Kernel";
			data = /incbin/("/home/albrecht/src/openwrt/build_dir/target-arm_cortex-a8+vfpv3_musl_eabi/linux-lan966x_generic/mchp_lan966x-pcb8290-kernel.bin");
			type = "kernel";
			arch = "arm";
			os = "linux";
			compression = "none";
			load = <0x60208000>;
			entry = <0x60208000>;
		};

		fdt_lan9668_ung8290_0_at_lan966x {
			description = "Flattened Device Tree";
			data = /incbin/("/home/albrecht/src/openwrt/build_dir/target-arm_cortex-a8+vfpv3_musl_eabi/linux-lan966x_generic/image-lan966x-pcb8290.dtb");
			type = "flat_dt";
			arch = "arm";
			load = <0x67e00000>;
			compression = "none";
		};

		ramdisk {
			description = "Ramdisk";
			data = /incbin/("/home/albrecht/src/openwrt/tmp/d20250707-977225-8cem4z/2/rootfs.squashfs");
			type = "ramdisk";
			arch = "arm";
			os = "linux";
			compression = "none";
			load = <0x68000000>;
		};

	};

	configurations {
		default = "lan9668_ung8290_0_at_lan966x";
		lan9668_ung8290_0_at_lan966x {
			description = "Kernel with DT fdt_lan9668_ung8290_0_at_lan966x";
			kernel = "kernel";
			fdt = "fdt_lan9668_ung8290_0_at_lan966x";
			ramdisk = "ramdisk";
		};

	};
};
```
